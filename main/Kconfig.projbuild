## main/Kconfig.projbuild
```kconfig
menu "WiFi Configuration"

config WIFI_SSID
    string "WiFi SSID"
    default "myssid"
    help
        SSID of the WiFi network

config WIFI_PASSWORD
    string "WiFi Password"
    default "mypassword"
    help
        Password of the WiFi network

endmenu

menu "Server Configuration"

config SERVER_IP
    string "Server IP Address"
    default "192.168.101.2"
    help
        IP address of the host running the consolidated Echoes server.

        All device traffic — OTA firmware, startup reports, and remote
        config — goes to a single process on SERVER_PORT (default 8002).

          GET  /firmware/version.txt   OTA version check
          GET  /firmware/echoes.bin    OTA binary download
          POST /startup                boot report
          GET  /config                 60-second parameter poll

config SERVER_PORT
    int "Server Port"
    default 8002
    help
        TCP port for the consolidated Echoes server.  All three services
        (OTA firmware, startup reports, remote config) are served from
        this single port.  Only change this if you have a specific reason
        to run the server on a different port.

endmenu
```

## scripts/sniffer/Kconfig.projbuild
```kconfig
menu "WiFi Configuration"

config WIFI_SSID
    string "WiFi SSID"
    default "myssid"
    help
        SSID of the WiFi network — must match the AP used by the Echoes fleet.

config WIFI_PASSWORD
    string "WiFi Password"
    default "mypassword"
    help
        Password of the WiFi network.

endmenu

menu "Sniffer Configuration"

config SNIFFER_BAUD_RATE
    int "UART baud rate for RPi output"
    default 115200
    help
        Baud rate for the UART0 serial output that the Raspberry Pi reads.
        115200 is fine for the message rates this mesh produces. Increase to
        921600 if you add extra verbose output.

endmenu
```

## scripts/sniffer/sdkconfig.defaults
```kconfig
# sdkconfig.defaults — echoes-sniffer
#
# Minimal settings needed for a stable WiFi + ESP-NOW receive-only node.
# The sniffer has no OTA, no NVS persistence, no audio hardware, and no
# watchdog subscribers beyond the idle task — keep it as simple as possible.

CONFIG_IDF_TARGET="esp32"

# 4 MB flash (same hardware as the fleet nodes)
CONFIG_ESPTOOLPY_FLASHSIZE_4MB=y
CONFIG_ESPTOOLPY_FLASHSIZE="4MB"

# 240 MHz CPU — same as fleet; keeps WiFi/ESP-NOW stack timing consistent
CONFIG_ESP_DEFAULT_CPU_FREQ_MHZ_240=y
CONFIG_ESP_DEFAULT_CPU_FREQ_MHZ=240

# 1 kHz tick rate — same as fleet; millis() accuracy
CONFIG_FREERTOS_HZ=1000

# Single-OTA partition table is fine — the sniffer is flashed manually,
# not via OTA.  Use the default "two OTA slots" table inherited from the
# toolchain; no custom partitions.csv needed.
CONFIG_PARTITION_TABLE_TWO_OTA=y

# Task Watchdog — enable but don't panic: the sniffer has no task that
# strictly must not stall, and a panic reboot mid-capture is annoying.
CONFIG_ESP_TASK_WDT_INIT=y
CONFIG_ESP_TASK_WDT_PANIC=n
CONFIG_ESP_TASK_WDT_TIMEOUT_S=30
CONFIG_ESP_TASK_WDT_CHECK_IDLE_TASK_CPU0=n
CONFIG_ESP_TASK_WDT_CHECK_IDLE_TASK_CPU1=n

# Interrupt WDT — keep enabled as a safety net
CONFIG_ESP_INT_WDT=y
CONFIG_ESP_INT_WDT_TIMEOUT_MS=300

# UART0 log output — this is what the Raspberry Pi reads
CONFIG_ESP_CONSOLE_UART_DEFAULT=y
CONFIG_ESP_CONSOLE_UART_NUM=0
CONFIG_ESP_CONSOLE_UART_BAUDRATE=115200

# Disable Bluetooth — not needed, saves ~60 kB RAM
CONFIG_BT_ENABLED=n

# WiFi — NVS is required by the WiFi driver even when we don't use it ourselves
CONFIG_NVS_FLASH_MAX_ENTRIES=64
```

## sdkconfig.defaults
```kconfig
CONFIG_IDF_TARGET="esp32"
CONFIG_ESPTOOLPY_FLASHSIZE_4MB=y
CONFIG_ESPTOOLPY_FLASHSIZE="4MB"
CONFIG_ESP_DEFAULT_CPU_FREQ_MHZ_240=y
CONFIG_ESP_DEFAULT_CPU_FREQ_MHZ=240
CONFIG_FREERTOS_HZ=1000
CONFIG_PARTITION_TABLE_CUSTOM=y
CONFIG_PARTITION_TABLE_FILENAME="partitions.csv"

# ── OTA rollback protection ───────────────────────────────────────────────────
CONFIG_BOOTLOADER_APP_ROLLBACK_ENABLE=y
CONFIG_BOOTLOADER_APP_ANTI_ROLLBACK=n

# ── Watchdogs ─────────────────────────────────────────────────────────────────
# Task Watchdog Timer — initialise at boot so esp_task_wdt_add() is always
# available regardless of whether esp_task_wdt_reconfigure/init succeeds at
# runtime.  Timeout matches WDT_TIMEOUT_S in echoes.h (30 s).  trigger_panic
# ensures a clean reboot with a backtrace rather than a silent hang.
# idle_core_mask=0 — do not watch idle tasks; only subscribed tasks matter.
CONFIG_ESP_TASK_WDT_INIT=y
CONFIG_ESP_TASK_WDT_PANIC=y
CONFIG_ESP_TASK_WDT_TIMEOUT_S=30
CONFIG_ESP_TASK_WDT_CHECK_IDLE_TASK_CPU0=n
CONFIG_ESP_TASK_WDT_CHECK_IDLE_TASK_CPU1=n
# Interrupt Watchdog — catches global interrupt masking that would prevent
# the Task WDT from firing.  300 ms default.  Fires a level-4 (NMI)
# interrupt that cannot be masked — last line of defence before the RTC WDT.
CONFIG_ESP_INT_WDT=y
CONFIG_ESP_INT_WDT_TIMEOUT_MS=300

# ── Stack overflow detection ──────────────────────────────────────────────────
# Canary-based detection for all tasks.  A corrupted stack could silently
# hang the scheduler without triggering any watchdog, because the TCB or
# WDT data structures may be in heap adjacent to the stack.
CONFIG_COMPILER_STACK_CHECK_MODE_STRONG=y

# ── Bluetooth — DISABLED ──────────────────────────────────────────────────────
# The firmware uses WiFi + ESP-NOW exclusively.  Bluetooth (Classic and BLE)
# is never initialised.  Disabling it frees the BT controller from IRAM
# (~60 KB) and removes the host stack from flash (~100 KB).  This is the
# single largest resource saving available.
CONFIG_BT_ENABLED=n

# ── TLS / mbedTLS — DISABLED ─────────────────────────────────────────────────
# All HTTP endpoints use plain http:// to a local IP address (see ota.h,
# remote_config.h, startup.h).  No certificate verification, no TLS handshake.
# Disabling HTTPS support in the HTTP client prevents mbedTLS from being
# linked, saving ~50–80 KB of RAM at runtime and ~200 KB of flash.
CONFIG_ESP_HTTP_CLIENT_ENABLE_HTTPS=n

# ── WiFi — STA-only, minimal feature set ─────────────────────────────────────
# The firmware connects as a station (STA) using WPA2-PSK.  SoftAP mode,
# WPA Enterprise (EAP), and WPS are never used.
#
# SoftAP: ~10–15 KB RAM saving; the node is never an access point.
CONFIG_ESP_WIFI_SOFTAP_SUPPORT=n
#
# WPA Enterprise / EAP: ~5–10 KB RAM saving; authentication is WPA2-PSK only.
CONFIG_ESP_WIFI_EAP_SUPPORT=n
#
# WPS: not used — credentials are baked in via Kconfig (WIFI_SSID / WIFI_PASSWORD).
CONFIG_ESP_WIFI_WPS_ENABLED=n
#
# NAN (Neighbour Awareness Networking): not used.
CONFIG_ESP_WIFI_NAN_ENABLE=n
#
# OPTIONAL — WPA3 SAE: the network is WPA2-PSK; WPA3 is not needed.
# Disabling it prevents mbedTLS from being pulled back in via the SAE
# handshake, and saves a further ~20 KB RAM.  Only safe if your AP does
# NOT use WPA3-SAE or WPA3-Transition mode.  Uncomment if you control the AP.
# CONFIG_ESP_WIFI_ENABLE_WPA3_SAE=n
# CONFIG_ESP_WIFI_ENABLE_WPA3_OWE_STA=n

# ── lwIP — trim unused protocol support ──────────────────────────────────────
# All remote communication targets a hardcoded IPv4 address on the local
# network.  IPv6, IGMP (multicast), PPP, and SLIP are unused.
#
# IPv6: ~10–15 KB RAM + flash.  The server URL is always a bare IPv4 address;
# no hostname resolution is ever performed.
CONFIG_LWIP_IPV6=n
#
# IGMP (multicast group management): not used — ESP-NOW uses its own
# broadcast mechanism; there is no IP multicast in the mesh.
CONFIG_LWIP_IGMP=n
#
# PPP / SLIP serial link protocols: not present on this hardware.
CONFIG_LWIP_PPP_SUPPORT=n
CONFIG_LWIP_SLIP_SUPPORT=n

# ── Power management — DISABLED ──────────────────────────────────────────────
# The firmware runs at 240 MHz continuously (audio DSP + I2S DMA require
# deterministic timing).  The PM subsystem adds overhead for a feature
# that is explicitly never invoked — ADC_ULP_MODE_DISABLE is set in code
# and no sleep modes are entered.
CONFIG_PM_ENABLE=n

# ── Core dump — DISABLED ─────────────────────────────────────────────────────
# The RTC diagnostic written by startup_write_rtc_diag() and the startup
# report sent to the server already capture the information needed for
# post-mortem analysis (reset cause, heap free, RSSI, uptime).  A full core
# dump requires a dedicated flash partition and is not retrieved from a
# deployed gallery installation.  Disabling it reclaims that partition space
# for the application binary.
CONFIG_ESP_COREDUMP_ENABLE_TO_NONE=y
```
